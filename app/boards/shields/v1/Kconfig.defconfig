## app/boards/shields/v1/Kconfig.defconfig
```kconfig
if SHIELD_V1_LEFT

config ZMK_KEYBOARD_NAME
    default "Austins Keyboard"

config ZMK_SPLIT_ROLE_CENTRAL
    default y

endif

if SHIELD_V1_LEFT || SHIELD_V1_RIGHT

config ZMK_SPLIT
    default y

endif
```

## app/boards/shields/v1/Kconfig.shield
```kconfig
config SHIELD_V1_LEFT
    def_bool $(shields_list_contains,v1_left)

config SHIELD_V1_RIGHT
    def_bool $(shields_list_contains,v1_right)
```
